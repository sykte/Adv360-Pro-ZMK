
bspc_delete: backspace_delete {
    compatible = "zmk,behavior-mod-morph";
    label = "BACKSPACE_DELETE";
    #binding-cells = <0>;
    bindings = <&kp BACKSPACE>, <&kp DELETE>;
    mods = <(MOD_LGUI|MOD_LSFT|MOD_RGUI|MOD_RSFT)>;
};
